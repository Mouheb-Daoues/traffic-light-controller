AUTOSAR XML (schema 4-3-1)
package /Interfaces
  sender receiver interface LightSignalInterface: is-service=true
    data couleur: category=VALUE, sw-addr-method=VAR, sw-calibration-access=READ-ONLY, type=Double
