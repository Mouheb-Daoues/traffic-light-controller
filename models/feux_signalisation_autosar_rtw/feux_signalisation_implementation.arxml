AUTOSAR XML (schema 4-3-1)
package /Components/SwcImplementations
  swc implementation feux_signalisation_Impl: programming-language=C, sw-version=1.12.1, used-code-generator=Embedded Coder 7.6 (R2021a) 14-Nov-2020, vendor-id=0, behavior=feux_signalisation_IB
    code-descriptors:
      code Code
        artifact-descriptors:
          short-label=feux_signalisation_c, category=SWSRC
          short-label=feux_signalisation_h, category=SWHDR
          short-label=feux_signalisation_private_h, category=SWHDR
          short-label=feux_signalisation_types_h, category=SWHDR
          short-label=rtwtypes_h, category=SWHDR
    resource consumption RsrcCons_feux_signalisation
